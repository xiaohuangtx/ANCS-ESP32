## main/Kconfig.projbuild
```kconfig
menu "ANCS-ESP32 Configuration"

menu "Bluetooth (ANCS)"

config BLE_DEVICE_NAME_PREFIX
    string "BLE device name prefix"
    default "ANCS"
    help
        Name shown in the iPhone Bluetooth settings is "<prefix>-XXXXXX",
        where XXXXXX is the last 3 bytes of the base MAC address.

config BLE_MAX_CONNECTIONS
    int "Default number of devices connected at the same time"
    range 1 BT_NIMBLE_MAX_CONNECTIONS
    default 1
    help
        Can be changed on the admin page (stored in NVS, namespace "ble",
        key "max_conn"), up to Component config > Bluetooth > NimBLE >
        Maximum number of concurrent connections.

config ANCS_IGNORE_PREEXISTING
    bool "Ignore pre-existing notifications"
    default n
    help
        After subscribing, iOS replays every notification that is already in
        Notification Center (flagged as "PreExisting"). Enable this to only
        report notifications that arrive after the connection is established.

config ANCS_FETCH_APP_NAME
    bool "Fetch app display name"
    default y
    help
        Query the display name (e.g. "WeChat") for each app identifier
        (e.g. "com.tencent.xin"). Results are cached in RAM.

config ANCS_MAX_TITLE_LEN
    int "Max title length (bytes)"
    range 16 512
    default 128

config ANCS_MAX_SUBTITLE_LEN
    int "Max subtitle length (bytes)"
    range 16 512
    default 128

config ANCS_MAX_MESSAGE_LEN
    int "Max message length (bytes)"
    range 32 1024
    default 512

endmenu

menu "Wi-Fi"

config WIFI_AP_SSID_PREFIX
    string "Provisioning hotspot SSID prefix"
    default "ANCS"
    help
        When no Wi-Fi is configured, the device opens a hotspot named
        "<prefix>-XXXXXX" (last 3 bytes of the base MAC address). Connect to it
        and open the web page to configure Wi-Fi.

endmenu

menu "Webhook"

config WEBHOOK_URL
    string "Default webhook URL"
    default ""
    help
        Notifications are POSTed as JSON to this URL. Leave empty to disable.
        Used as the first push target until targets are set on the admin page
        (stored in NVS, namespace "webhook", keys "t0".."t2").

config WEBHOOK_AUTH_TOKEN
    string "Default Authorization header"
    default ""
    help
        Optional value of the HTTP "Authorization" header, e.g. "Bearer xxx",
        for CONFIG_WEBHOOK_URL.

config WEBHOOK_TIMEOUT_MS
    int "HTTP timeout (ms)"
    range 1000 60000
    default 5000

config WEBHOOK_QUEUE_SIZE
    int "Pending notification queue size"
    range 1 64
    default 16

endmenu

menu "Time"

config TIME_DEFAULT_UTC_OFFSET
    int "Default UTC offset (minutes)"
    range -720 840
    default 480
    help
        Time zone used until an iPhone has reported its own (Current Time
        Service), e.g. 480 for UTC+8. The offset reported by the iPhone is
        stored in NVS (namespace "time", key "utc_off") and takes precedence.

config TIME_SYNC_NTP
    bool "Sync the clock with SNTP"
    default y
    help
        While Wi-Fi is connected. Without it, the clock is only set from the
        iPhone when it connects.

config TIME_NTP_SERVER
    string "SNTP server"
    default "ntp.aliyun.com"
    depends on TIME_SYNC_NTP

config TIME_NTP_SERVER_2
    string "Second SNTP server"
    default "pool.ntp.org"
    depends on TIME_SYNC_NTP
    help
        Needs LWIP_SNTP_MAX_SERVERS >= 2. Leave empty to use one server only.

endmenu

menu "Admin web page"

config NOTIFICATION_HISTORY_SIZE
    int "Default number of notifications kept"
    range 1 100
    default 30
    help
        The most recent notifications are shown on the admin page
        (http://<device IP>/). Can be changed on the page; the value is stored
        in NVS (namespace "history", key "size"). With a "storage" partition
        (partitions/16m.csv) notifications and their webhook delivery state are
        also kept in flash (first 2 MB of it) and reloaded on boot; otherwise
        (4m.csv / 8m.csv) they are lost on reboot.

config WEB_ADMIN_PASSWORD
    string "Default admin password"
    default ""
    help
        If set, the admin page asks for HTTP Basic auth (user "admin").
        Leave empty for no password, at most 64 bytes. Can be changed on the page; the value is
        stored in NVS (namespace "web", key "password").

endmenu

config BOOT_BUTTON_GPIO
    int "Boot button GPIO (-1 to disable)"
    range -1 48
    default 9 if IDF_TARGET_ESP32C3 || IDF_TARGET_ESP32C6
    default 0
    help
        Long press: enter Wi-Fi provisioning mode.
        Triple click: erase all BLE bonds.

endmenu
```

## sdkconfig.defaults
```kconfig
CONFIG_COMPILER_OPTIMIZATION_SIZE=y
CONFIG_COMPILER_CXX_EXCEPTIONS=y
CONFIG_COMPILER_CXX_EXCEPTIONS_EMG_POOL_SIZE=1024

CONFIG_BOOTLOADER_APP_ROLLBACK_ENABLE=y

CONFIG_HTTPD_MAX_REQ_HDR_LEN=2048
CONFIG_HTTPD_MAX_URI_LEN=2048

CONFIG_PARTITION_TABLE_CUSTOM=y
CONFIG_PARTITION_TABLE_CUSTOM_FILENAME="partitions/4m.csv"
CONFIG_PARTITION_TABLE_OFFSET=0x8000
CONFIG_ESPTOOLPY_FLASHSIZE_4MB=y

CONFIG_ESP_TASK_WDT_TIMEOUT_S=10
CONFIG_ESP_MAIN_TASK_STACK_SIZE=8192
CONFIG_ESP_SYSTEM_EVENT_TASK_STACK_SIZE=4096

# Wi-Fi: keep RAM usage low so BLE + Wi-Fi + TLS fit without PSRAM
CONFIG_MBEDTLS_DYNAMIC_BUFFER=y
CONFIG_MBEDTLS_DYNAMIC_FREE_CONFIG_DATA=y
CONFIG_MBEDTLS_SSL_KEEP_PEER_CERTIFICATE=n
CONFIG_MBEDTLS_SSL_RENEGOTIATION=n
CONFIG_ESP_WIFI_IRAM_OPT=n
CONFIG_ESP_WIFI_RX_IRAM_OPT=n
CONFIG_ESP_WIFI_DYNAMIC_RX_MGMT_BUFFER=y
CONFIG_ESP_WIFI_STATIC_RX_BUFFER_NUM=6
CONFIG_ESP_WIFI_DYNAMIC_RX_BUFFER_NUM=8
CONFIG_ESP_WIFI_ENTERPRISE_SUPPORT=n
CONFIG_NEWLIB_NANO_FORMAT=y

# Bluetooth: NimBLE host, BLE only
CONFIG_BT_ENABLED=y
CONFIG_BT_NIMBLE_ENABLED=y
CONFIG_BT_BLUEDROID_ENABLED=n
CONFIG_BT_NIMBLE_NVS_PERSIST=y
CONFIG_BT_NIMBLE_MAX_CONNECTIONS=1
# GATT client (needed for ANCS) is only compiled with the central role
CONFIG_BT_NIMBLE_ROLE_CENTRAL=y
CONFIG_BT_NIMBLE_GATT_CLIENT=y
CONFIG_BT_NIMBLE_ROLE_OBSERVER=n
CONFIG_BT_NIMBLE_MAX_BONDS=4
CONFIG_BT_NIMBLE_ATT_PREFERRED_MTU=512
CONFIG_BT_NIMBLE_SM_SC=y
CONFIG_BT_NIMBLE_GAP_DEVICE_NAME_MAX_LEN=31
CONFIG_BT_NIMBLE_LOG_LEVEL_WARNING=y
CONFIG_BT_NIMBLE_HOST_TASK_STACK_SIZE=5120

# Wi-Fi / BLE coexistence
CONFIG_ESP_COEX_SW_COEXIST_ENABLE=y
```
